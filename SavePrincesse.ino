#include <SPI.h>
#include <Gamebuino.h>
Gamebuino gb;

const byte Mechant[] PROGMEM = {16,16,0x0,0x1F,0x0,0x11,0x0,0x15,0x0,0x19,0x0,0xF,0x4,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0x5,};
const byte Mechant1[] PROGMEM = {16,16,0x0,0x1F,0x0,0x11,0x0,0x15,0x0,0x19,0x0,0xF,0x0,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0x5,};
const byte prince[] PROGMEM = {16,16,0x0,0x0,0x7,0x1,0x8,0x82,0x8,0x84,0x7,0x48,0x2,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0x80,};
const byte prince1[] PROGMEM = {16,16,0x0,0x0,0x7,0x0,0x8,0x80,0x8,0x80,0x7,0x0,0x2,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0x80,};


const byte WorldSmall[] PROGMEM = {88,44,0x2,0xA0,0x0,0x0,0x0,0x0,0x0,0x0,0x0,0x0,0x0,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0xFF,};
//Position en X du chevalier
int xpos = 0;
//position en X du mechant
int xposMe = 0;
//si true le mechant a l'épee en mode attaque
bool attkmechant=false;
void setup()
{
  gb.begin();
 goTitleScreen();
 gb.battery.show = false;
}

void goTitleScreen()
{
  gb.titleScreen(F("Sauve la princesse"));
  initGame();
}
void initGame()
{
  //on met tout le monde en position initiale
  xpos = 0;
  xposMe = 16;
  attkmechant=false;
}

void loop(){
    if(gb.update())
    {
      
      if(gb.buttons.pressed(BTN_C))
      {
        //si on appuis sur C on retourne au menu principal
        goTitleScreen();
      }
      //on dessine le monde en position 0,0. le monde fait exatement la taille de l'ecran
      gb.display.drawBitmap(0,0,WorldSmall);
      //BTN_UP, BTN_RIGHT, BTN_DOWN, BTN_LEFT
       if(gb.buttons.repeat(BTN_RIGHT,1))
       {
         //si on appuis sur droite le chevalier va avancer de 1 px : xpos++
          if(!gb.collideBitmapBitmap(xpos, 28, prince1, xposMe, 28, Mechant1))//si je suis pas en collision avec le mechant
             xpos++;
       }
       else if  (gb.buttons.repeat(BTN_LEFT,1))
       {
         //je peut aussi reculer :0
         xpos--;
       }
       // on ne doit pas sortir de l'ecran
         if(xpos<0) xpos = 0;
         if(xpos>72) xpos = 72; // = 88 px de l'ecran de large - 16 px du chevalier
         
       if(gb.buttons.repeat(BTN_A,1))
       {
         //le chevalier donne un coup d'epee
        gb.display.drawBitmap(xpos,28,prince1);
        gb.sound.playTick();
       }
       else 
       {
         //le chevalier ne donne pas de coup d'epee
        gb.display.drawBitmap(xpos,28,prince);
       }
       if(gb.buttons.pressed(BTN_A) && gb.collideBitmapBitmap(xpos, 28, prince1, xposMe, 28, Mechant1))
       {
           //je touche le mechant recule de 4 px
           xposMe +=4;
           gb.sound.playOK();
       }
       
       //gestion du méchant 
       if(attkmechant)
       {
         //le mechant attaque 
          gb.display.drawBitmap(xposMe,28,Mechant1);
       }
       else 
       {
         //le mechant n'attaque pas
          gb.display.drawBitmap(xposMe,28,Mechant);
       }
       
       if(!gb.collideBitmapBitmap(xpos, 28, prince1, xposMe, 28, Mechant1))
       {
         //si le mechant le peux il avance vers le joueur
           xposMe--;
       }
       
       if(random(0,6)==0)//une chance sur 6 a chaque frame (20/ seconde de base)
       {
         // on change d'etat le mechant
         attkmechant = !attkmechant;
         if(attkmechant && gb.collideBitmapBitmap(xpos, 28, prince1, xposMe, 28, Mechant1))
         {
           //si il attaque et qu'il me touche ça fait mal je recule

           xpos -=4;//je recule de 4
           xposMe -=1;//le mechant avance de 1
           
           gb.sound.playOK();
         }
       }
       //SECURITE : le mechant ne peut pas aller derriere moi .
       if(xposMe<xpos)
       {
         xposMe = xpos+10;
       }
       
       //j'arrive au porte du chateau (pos>66) j'entre BTN_B
       if(xpos > 66 && gb.buttons.pressed(BTN_B))
       {
        victorie();//Et c'est gagner !
       }
    }
}

void victorie()
{
  while(true)
  {
    if(gb.update())
    {
      gb.display.println("Youhou !");
      gb.display.print("appuis sur ");
      gb.display.print("A");
      if(gb.buttons.pressed(BTN_A))
       {
         break;
       }
    }
  }
  goTitleScreen();
  
}
